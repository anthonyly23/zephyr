## CMakeLists.txt
```
# SPDX-License-Identifier: Apache-2.0

cmake_minimum_required(VERSION 3.20.0)
find_package(Zephyr REQUIRED HINTS $ENV{ZEPHYR_BASE})
project(vendor_bulk)

include(${ZEPHYR_BASE}/samples/subsys/usb/common/common.cmake)
FILE(GLOB app_sources src/*.c)
target_sources(app PRIVATE ${app_sources})
```

## Kconfig
```
# Copyright (c) 2026 Zephyr contributors
# SPDX-License-Identifier: Apache-2.0

mainmenu "Vendor-class bulk sample"

config APP_VENDOR_BULK_PRODUCER
	bool "Run a producer thread that fills the bulk IN endpoint"
	default y
	help
	  When enabled, a Zephyr thread continuously generates a counter
	  pattern and submits it on the bulk IN endpoint. When disabled, the
	  custom class auto-re-enqueues echo from OUT into IN (loopback).

config APP_VENDOR_BULK_XFER_SIZE
	int "Per-transfer size (bytes)"
	default 16384
	range 64 131072
	help
	  Size of each bulk IN/OUT transfer. Must be a multiple of 64 (FS) or
	  512 (HS) for best throughput. Bound by CONFIG_UDC_BUF_POOL_SIZE.

config APP_VENDOR_BULK_IN_DEPTH
	int "Number of bulk IN transfers kept in flight"
	default 4
	range 1 16
	help
	  Pipeline depth for the bulk IN endpoint. Higher values keep the USB
	  controller busy across software latency between transfers, at the
	  cost of XFER_SIZE * IN_DEPTH bytes of RAM. UDC pool must be sized to
	  hold all outstanding buffers (UDC_BUF_COUNT >= IN_DEPTH + 2).

source "samples/subsys/usb/common/Kconfig.sample_usbd"

source "Kconfig.zephyr"
```

## sample.yaml
```
sample:
  name: USB Vendor-Class Bulk
tests:
  sample.usb_device_next.vendor_bulk:
    depends_on: usbd
    tags: usb
    integration_platforms:
      - frdm_k64f
    harness: console
    harness_config:
      type: one_line
      regex:
        - "Vendor bulk class registered"
```

## prj.conf
```kconfig
# USB device-next stack
CONFIG_USB_DEVICE_STACK_NEXT=y

CONFIG_STDOUT_CONSOLE=y

# Logging (errors only -> minimal overhead in the data path)
CONFIG_LOG=y
CONFIG_USBD_LOG_LEVEL_ERR=y
CONFIG_UDC_DRIVER_LOG_LEVEL_ERR=y

# UDC buffer pool: 4 x 16 KiB IN transfers + headroom.
CONFIG_UDC_BUF_COUNT=32
CONFIG_UDC_BUF_POOL_SIZE=81920

# Place UDC buffers in non-cached SRAM so the driver does not have to flush
# the data cache on every IN transfer (huge throughput win on M55).
CONFIG_NOCACHE_MEMORY=y
CONFIG_UDC_BUF_FORCE_NOCACHE=y

# Sample app options
CONFIG_APP_VENDOR_BULK_PRODUCER=y
CONFIG_APP_VENDOR_BULK_XFER_SIZE=32768
CONFIG_APP_VENDOR_BULK_IN_DEPTH=2

# Vendor / Product (Zephyr project IDs - do NOT ship outside samples)
CONFIG_SAMPLE_USBD_VID=0x2fe3
CONFIG_SAMPLE_USBD_PID=0x000a
CONFIG_SAMPLE_USBD_PRODUCT="Zephyr vendor bulk sample"

# Disable the CDC ACM serial-at-boot helper that some boards default-enable.
CONFIG_CDC_ACM_SERIAL_INITIALIZE_AT_BOOT=n
```

## app.overlay
```dts
/*
 * Copyright (c) 2026 Zephyr contributors
 * SPDX-License-Identifier: Apache-2.0
 */

&zephyr_udc0 {
	status = "okay";
};
```

## src/main.c
```c
/*
 * Copyright (c) 2026 Zephyr contributors
 * SPDX-License-Identifier: Apache-2.0
 *
 * Vendor-class bulk sample app: enables the USB device and, in producer mode,
 * continuously submits a counter pattern on the bulk IN endpoint. Pipelining
 * is handled by submitting the next IN transfer from the completion hook,
 * which runs in USB-stack context.
 */

#include <sample_usbd.h>

#include <zephyr/kernel.h>
#include <zephyr/usb/usbd.h>
#include <zephyr/logging/log.h>

#include "vendor_bulk.h"

LOG_MODULE_REGISTER(main, LOG_LEVEL_INF);

#if CONFIG_APP_VENDOR_BULK_PRODUCER

#define IN_DEPTH CONFIG_APP_VENDOR_BULK_IN_DEPTH
#define XFER_SIZE CONFIG_APP_VENDOR_BULK_XFER_SIZE

/* Single source buffer reused for every IN transfer. The class driver memcpys
 * its content into a UDC net_buf at submit time, so the host receives a
 * deterministic pattern but we avoid touching this memory on the hot path.
 */
static uint8_t in_buf[XFER_SIZE];

static void fill_pattern_once(void)
{
	for (size_t i = 0; i < XFER_SIZE; i += sizeof(uint32_t)) {
		uint32_t v = (uint32_t)(i / sizeof(uint32_t));

		in_buf[i + 0] = (uint8_t)(v);
		in_buf[i + 1] = (uint8_t)(v >> 8);
		in_buf[i + 2] = (uint8_t)(v >> 16);
		in_buf[i + 3] = (uint8_t)(v >> 24);
	}
}

static void refill_pipeline(void)
{
	while (vendor_bulk_in_inflight() < IN_DEPTH) {
		int err = vendor_bulk_in_submit(in_buf, XFER_SIZE);

		if (err) {
			LOG_WRN("submit failed (%d)", err);
			return;
		}
	}
}

void vendor_bulk_on_enable(void)
{
	refill_pipeline();
}

void vendor_bulk_on_in_complete(void)
{
	refill_pipeline();
}

#else /* loopback mode - main has nothing to do */

void vendor_bulk_on_enable(void) {}
void vendor_bulk_on_in_complete(void) {}

#endif

int main(void)
{
	struct usbd_context *sample_usbd;
	int err;

#if CONFIG_APP_VENDOR_BULK_PRODUCER
	fill_pattern_once();
#endif

	sample_usbd = sample_usbd_init_device(NULL);
	if (sample_usbd == NULL) {
		LOG_ERR("sample_usbd_init_device failed");
		return -ENODEV;
	}

	if (!usbd_can_detect_vbus(sample_usbd)) {
		err = usbd_enable(sample_usbd);
		if (err) {
			LOG_ERR("usbd_enable failed (%d)", err);
			return err;
		}
	}

	LOG_INF("USB vendor bulk sample running (%s mode)",
		IS_ENABLED(CONFIG_APP_VENDOR_BULK_PRODUCER) ?
			"producer" : "loopback");
	return 0;
}
```

## src/vendor_bulk.c
```c
/*
 * Copyright (c) 2026 Zephyr contributors
 *
 * Custom vendor-class USB function with a single interface that exposes one
 * bulk IN endpoint and one bulk OUT endpoint. Derived from
 * `subsys/usb/device_next/class/loopback.c` but trimmed to the minimum needed
 * for high-throughput vendor bulk transfers.
 *
 * Two operating modes:
 *   - Producer mode (CONFIG_APP_VENDOR_BULK_PRODUCER=y): an external thread
 *     fills the bulk IN endpoint via vendor_bulk_in_submit(); incoming OUT
 *     traffic is dropped and re-armed automatically.
 *   - Loopback mode (=n): copies OUT->IN automatically, like the upstream
 *     loopback class.
 *
 * SPDX-License-Identifier: Apache-2.0
 */

#include <zephyr/kernel.h>
#include <zephyr/sys/atomic.h>
#include <zephyr/sys/byteorder.h>
#include <zephyr/usb/usbd.h>
#include <zephyr/drivers/usb/udc.h>
#include <zephyr/logging/log.h>

#include "vendor_bulk.h"

LOG_MODULE_REGISTER(vendor_bulk, LOG_LEVEL_INF);

#define VB_BULK_FS_MPS 64
#define VB_BULK_HS_MPS 512

/* state bits */
#define VB_ENABLED        0
#define VB_OUT_ENGAGED    1

struct vb_desc {
	struct usb_if_descriptor if0;
	struct usb_ep_descriptor if0_out_ep;
	struct usb_ep_descriptor if0_in_ep;
	struct usb_ep_descriptor if0_hs_out_ep;
	struct usb_ep_descriptor if0_hs_in_ep;
	struct usb_desc_header nil_desc;
};

struct vb_data {
	struct vb_desc *const desc;
	const struct usb_desc_header **const fs_desc;
	const struct usb_desc_header **const hs_desc;
	atomic_t state;
	atomic_t in_inflight;
#if !IS_ENABLED(CONFIG_APP_VENDOR_BULK_PRODUCER)
	/* Sink buffer for OUT data only used in loopback mode. */
	uint8_t out_sink[CONFIG_APP_VENDOR_BULK_XFER_SIZE];
#endif
};

static struct usbd_class_data *vb_class_data;

static uint8_t vb_get_bulk_out(struct usbd_class_data *const c_data)
{
	struct vb_data *data = usbd_class_get_private(c_data);
	struct usbd_context *uds_ctx = usbd_class_get_ctx(c_data);

	if (usbd_bus_speed(uds_ctx) == USBD_SPEED_HS) {
		return data->desc->if0_hs_out_ep.bEndpointAddress;
	}

	return data->desc->if0_out_ep.bEndpointAddress;
}

static uint8_t vb_get_bulk_in(struct usbd_class_data *const c_data)
{
	struct vb_data *data = usbd_class_get_private(c_data);
	struct usbd_context *uds_ctx = usbd_class_get_ctx(c_data);

	if (usbd_bus_speed(uds_ctx) == USBD_SPEED_HS) {
		return data->desc->if0_hs_in_ep.bEndpointAddress;
	}

	return data->desc->if0_in_ep.bEndpointAddress;
}

static int vb_submit_bulk_out(struct usbd_class_data *const c_data)
{
	struct vb_data *data = usbd_class_get_private(c_data);
	struct net_buf *buf;
	int err;

	if (!atomic_test_bit(&data->state, VB_ENABLED)) {
		return -EPERM;
	}

	if (atomic_test_and_set_bit(&data->state, VB_OUT_ENGAGED)) {
		return -EBUSY;
	}

	buf = usbd_ep_buf_alloc(c_data, vb_get_bulk_out(c_data),
				CONFIG_APP_VENDOR_BULK_XFER_SIZE);
	if (buf == NULL) {
		atomic_clear_bit(&data->state, VB_OUT_ENGAGED);
		LOG_ERR("OUT buf alloc failed");
		return -ENOMEM;
	}

	err = usbd_ep_enqueue(c_data, buf);
	if (err) {
		atomic_clear_bit(&data->state, VB_OUT_ENGAGED);
		net_buf_unref(buf);
		LOG_ERR("OUT enqueue failed (%d)", err);
	}

	return err;
}

#if !IS_ENABLED(CONFIG_APP_VENDOR_BULK_PRODUCER)
/* Loopback variant - copies sink into a new IN buffer. */
static int vb_submit_bulk_in_echo(struct usbd_class_data *const c_data)
{
	struct vb_data *data = usbd_class_get_private(c_data);
	struct net_buf *buf;
	int err;

	if (!atomic_test_bit(&data->state, VB_ENABLED)) {
		return -EPERM;
	}

	buf = usbd_ep_buf_alloc(c_data, vb_get_bulk_in(c_data),
				CONFIG_APP_VENDOR_BULK_XFER_SIZE);
	if (buf == NULL) {
		return -ENOMEM;
	}

	net_buf_add_mem(buf, data->out_sink,
			MIN(sizeof(data->out_sink), net_buf_tailroom(buf)));

	atomic_inc(&data->in_inflight);
	err = usbd_ep_enqueue(c_data, buf);
	if (err) {
		atomic_dec(&data->in_inflight);
		net_buf_unref(buf);
	}

	return err;
}
#endif

/* Producer-mode public API: submit an arbitrary payload on bulk IN. */
int vendor_bulk_in_submit(const uint8_t *payload, size_t len)
{
	struct usbd_class_data *c_data = vb_class_data;
	struct vb_data *data;
	struct net_buf *buf;
	int err;

	if (c_data == NULL) {
		return -ENODEV;
	}

	data = usbd_class_get_private(c_data);

	if (!atomic_test_bit(&data->state, VB_ENABLED)) {
		return -ENETDOWN;
	}

	buf = usbd_ep_buf_alloc(c_data, vb_get_bulk_in(c_data), len);
	if (buf == NULL) {
		return -ENOMEM;
	}

	net_buf_add_mem(buf, payload, MIN(len, net_buf_tailroom(buf)));

	atomic_inc(&data->in_inflight);
	err = usbd_ep_enqueue(c_data, buf);
	if (err) {
		atomic_dec(&data->in_inflight);
		net_buf_unref(buf);
	}

	return err;
}

int vendor_bulk_in_inflight(void)
{
	struct usbd_class_data *c_data = vb_class_data;
	struct vb_data *data;

	if (c_data == NULL) {
		return 0;
	}

	data = usbd_class_get_private(c_data);
	return (int)atomic_get(&data->in_inflight);
}

bool vendor_bulk_is_ready(void)
{
	struct usbd_class_data *c_data = vb_class_data;
	struct vb_data *data;

	if (c_data == NULL) {
		return false;
	}

	data = usbd_class_get_private(c_data);
	return atomic_test_bit(&data->state, VB_ENABLED);
}

static int vb_request_handler(struct usbd_class_data *const c_data,
			      struct net_buf *const buf, const int err)
{
	struct vb_data *data = usbd_class_get_private(c_data);
	struct udc_buf_info *bi = (struct udc_buf_info *)net_buf_user_data(buf);
	const uint8_t ep = bi->ep;

	if (ep == vb_get_bulk_out(c_data)) {
		atomic_clear_bit(&data->state, VB_OUT_ENGAGED);
#if !IS_ENABLED(CONFIG_APP_VENDOR_BULK_PRODUCER)
		if (err == 0) {
			memcpy(data->out_sink, buf->data,
			       MIN(sizeof(data->out_sink), buf->len));
		}
#endif
	} else if (ep == vb_get_bulk_in(c_data)) {
		atomic_dec(&data->in_inflight);
	}

	net_buf_unref(buf);

	if (err == -ECONNABORTED) {
		LOG_INF("Transfer ep 0x%02x cancelled", ep);
		return 0;
	} else if (err) {
		LOG_ERR("Transfer ep 0x%02x failed (%d)", ep, err);
		return err;
	}

	/* Re-arm. In producer mode, IN is driven by the app thread. */
	if (ep == vb_get_bulk_out(c_data)) {
		(void)vb_submit_bulk_out(c_data);
	}
#if !IS_ENABLED(CONFIG_APP_VENDOR_BULK_PRODUCER)
	if (ep == vb_get_bulk_in(c_data)) {
		(void)vb_submit_bulk_in_echo(c_data);
	}
#else
	if (ep == vb_get_bulk_in(c_data)) {
		vendor_bulk_on_in_complete();
	}
#endif

	return 0;
}

static void vb_update(struct usbd_class_data *c_data, uint8_t iface, uint8_t alt)
{
	ARG_UNUSED(c_data);
	ARG_UNUSED(iface);
	ARG_UNUSED(alt);
}

static void *vb_get_desc(struct usbd_class_data *const c_data,
			 const enum usbd_speed speed)
{
	struct vb_data *data = usbd_class_get_private(c_data);

	if (USBD_SUPPORTS_HIGH_SPEED && speed == USBD_SPEED_HS) {
		return data->hs_desc;
	}

	return data->fs_desc;
}

static void vb_enable(struct usbd_class_data *const c_data)
{
	struct vb_data *data = usbd_class_get_private(c_data);

	LOG_INF("Enable %s", c_data->name);
	if (!atomic_test_and_set_bit(&data->state, VB_ENABLED)) {
#if !IS_ENABLED(CONFIG_APP_VENDOR_BULK_PRODUCER)
		/* Loopback mode: arm OUT and IN. In producer mode we skip OUT
		 * to keep the entire UDC pool available for IN transfers.
		 */
		(void)vb_submit_bulk_out(c_data);
		(void)vb_submit_bulk_in_echo(c_data);
#else
		vendor_bulk_on_enable();
#endif
	}
}

static void vb_disable(struct usbd_class_data *const c_data)
{
	struct vb_data *data = usbd_class_get_private(c_data);

	atomic_clear_bit(&data->state, VB_ENABLED);
	LOG_INF("Disable %s", c_data->name);
}

static int vb_init(struct usbd_class_data *c_data)
{
	vb_class_data = c_data;
	LOG_INF("Vendor bulk class registered");
	return 0;
}

static struct usbd_class_api vb_api = {
	.update = vb_update,
	.request = vb_request_handler,
	.get_desc = vb_get_desc,
	.enable = vb_enable,
	.disable = vb_disable,
	.init = vb_init,
};

static struct vb_desc vb_desc_0 = {
	.if0 = {
		.bLength = sizeof(struct usb_if_descriptor),
		.bDescriptorType = USB_DESC_INTERFACE,
		.bInterfaceNumber = 0,
		.bAlternateSetting = 0,
		.bNumEndpoints = 2,
		.bInterfaceClass = USB_BCC_VENDOR,
		.bInterfaceSubClass = 0,
		.bInterfaceProtocol = 0,
		.iInterface = 0,
	},
	.if0_out_ep = {
		.bLength = sizeof(struct usb_ep_descriptor),
		.bDescriptorType = USB_DESC_ENDPOINT,
		.bEndpointAddress = 0x01,
		.bmAttributes = USB_EP_TYPE_BULK,
		.wMaxPacketSize = sys_cpu_to_le16(VB_BULK_FS_MPS),
		.bInterval = 0x00,
	},
	.if0_in_ep = {
		.bLength = sizeof(struct usb_ep_descriptor),
		.bDescriptorType = USB_DESC_ENDPOINT,
		.bEndpointAddress = 0x81,
		.bmAttributes = USB_EP_TYPE_BULK,
		.wMaxPacketSize = sys_cpu_to_le16(VB_BULK_FS_MPS),
		.bInterval = 0x00,
	},
	.if0_hs_out_ep = {
		.bLength = sizeof(struct usb_ep_descriptor),
		.bDescriptorType = USB_DESC_ENDPOINT,
		.bEndpointAddress = 0x01,
		.bmAttributes = USB_EP_TYPE_BULK,
		.wMaxPacketSize = sys_cpu_to_le16(VB_BULK_HS_MPS),
		.bInterval = 0x00,
	},
	.if0_hs_in_ep = {
		.bLength = sizeof(struct usb_ep_descriptor),
		.bDescriptorType = USB_DESC_ENDPOINT,
		.bEndpointAddress = 0x81,
		.bmAttributes = USB_EP_TYPE_BULK,
		.wMaxPacketSize = sys_cpu_to_le16(VB_BULK_HS_MPS),
		.bInterval = 0x00,
	},
	.nil_desc = {
		.bLength = 0,
		.bDescriptorType = 0,
	},
};

static const struct usb_desc_header *vb_fs_desc[] = {
	(struct usb_desc_header *)&vb_desc_0.if0,
	(struct usb_desc_header *)&vb_desc_0.if0_out_ep,
	(struct usb_desc_header *)&vb_desc_0.if0_in_ep,
	(struct usb_desc_header *)&vb_desc_0.nil_desc,
};

static const struct usb_desc_header *vb_hs_desc[] = {
	(struct usb_desc_header *)&vb_desc_0.if0,
	(struct usb_desc_header *)&vb_desc_0.if0_hs_out_ep,
	(struct usb_desc_header *)&vb_desc_0.if0_hs_in_ep,
	(struct usb_desc_header *)&vb_desc_0.nil_desc,
};

static struct vb_data vb_data_0 = {
	.desc = &vb_desc_0,
	.fs_desc = vb_fs_desc,
	.hs_desc = vb_hs_desc,
};

USBD_DEFINE_CLASS(vendor_bulk_0, &vb_api, &vb_data_0, NULL);
```

## src/vendor_bulk.h
```c
/*
 * Copyright (c) 2026 Zephyr contributors
 * SPDX-License-Identifier: Apache-2.0
 */

#ifndef SAMPLES_USB_VENDOR_BULK_H_
#define SAMPLES_USB_VENDOR_BULK_H_

#include <stddef.h>
#include <stdint.h>
#include <stdbool.h>

#ifdef __cplusplus
extern "C" {
#endif

/**
 * Submit a bulk IN transfer on the vendor-class endpoint.
 *
 * Producer-mode only (CONFIG_APP_VENDOR_BULK_PRODUCER=y). The class driver
 * allocates a UDC buffer, copies @p payload into it, and enqueues it on the
 * bulk IN endpoint. Multiple transfers may be in flight concurrently up to
 * the limit imposed by the UDC pool; submission only fails on -ENOMEM /
 * -ENETDOWN, never -EBUSY.
 */
int vendor_bulk_in_submit(const uint8_t *payload, size_t len);

/** Number of bulk IN transfers currently queued in the USB controller. */
int vendor_bulk_in_inflight(void);

/** True after the host has configured the device and bulk EPs are armed. */
bool vendor_bulk_is_ready(void);

/* Application-side hooks (weak in practice; the sample provides them). */
void vendor_bulk_on_enable(void);
void vendor_bulk_on_in_complete(void);

#ifdef __cplusplus
}
#endif

#endif /* SAMPLES_USB_VENDOR_BULK_H_ */
```
